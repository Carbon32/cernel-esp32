## main/Kconfig.projbuild
```kconfig
menu "Carblang script server"

config CARBLANG_UPLOAD_TOKEN
    string "Bytecode upload token"
    default "default_carblang_token"
    help
        Shared token required to upload bytecode over TCP port 3333.

endmenu
```
